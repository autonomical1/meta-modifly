## conf/layer.conf
```bitbake
# We have a conf and classes directory, add to BBPATH
BBPATH .= ":${LAYERDIR}"

# We have recipes-* directories, add to BBFILES
BBFILES += "${LAYERDIR}/recipes-*/*/*.bb \
            ${LAYERDIR}/recipes-*/*/*.bbappend"

BBFILE_COLLECTIONS += "meta-modifly"
BBFILE_PATTERN_meta-modifly = "^${LAYERDIR}/"
BBFILE_PRIORITY_meta-modifly = "10"

LAYERDEPENDS_meta-modifly = "core"
LAYERSERIES_COMPAT_meta-modifly = "scarthgap"
```
